## conf/layer.conf
```bitbake
# We have a conf and classes directory, add to BBPATH
BBPATH .= ":${LAYERDIR}"
# We have recipes-* directories, add to BBFILES
BBFILES += "${LAYERDIR}/recipes-*/*/*.bb"

BBFILE_COLLECTIONS += "phosh-layer"
BBFILE_PATTERN_phosh-layer = "^${LAYERDIR}/"
BBFILE_PRIORITY_phosh-layer = "6"

LAYERSERIES_COMPAT_phosh-layer = "gatesgarth hardknott"

LAYERDEPENDS_phosh-layer = "core gnome-layer"
```
